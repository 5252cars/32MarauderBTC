## sdkconfig.defaults
```kconfig
# ESP32-S3 specific configurations
CONFIG_IDF_TARGET="esp32s3"
CONFIG_ESPTOOLPY_FLASHMODE_QIO=y
CONFIG_ESPTOOLPY_FLASHFREQ_80M=y
CONFIG_ESPTOOLPY_FLASHSIZE_16MB=y

# WiFi configurations
CONFIG_ESP_WIFI_SSID="YourWiFiSSID"
CONFIG_ESP_WIFI_PASSWORD="YourWiFiPassword"
CONFIG_ESP_MAXIMUM_RETRY=5

# HTTP client configurations
CONFIG_ESP_HTTP_CLIENT_ENABLE_HTTPS=y

# Display configurations for Waveshare ESP32-S3-LCD-1.47
CONFIG_LCD_TYPE_ST7789V=y
CONFIG_LCD_WIDTH=172
CONFIG_LCD_HEIGHT=320

# FreeRTOS configurations
CONFIG_FREERTOS_HZ=1000

# Bluetooth configurations (disable to save memory)
CONFIG_BT_ENABLED=n

# Debug configurations
CONFIG_ESP_CONSOLE_UART_DEFAULT=y
CONFIG_ESP_CONSOLE_UART_BAUDRATE=115200

# Auto-start configurations
CONFIG_BTC_CLOCK_AUTOSTART=y
CONFIG_BTC_CLOCK_UPDATE_INTERVAL=60000
```
